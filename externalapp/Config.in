## externalapp/Config.in
```kconfig
source "$BR2_EXTERNAL_ECHOFORD_EXTERNAL_APP_PATH/package/hello_world/Config.in"
source "$BR2_EXTERNAL_ECHOFORD_EXTERNAL_APP_PATH/src/driver/dht11/Config.in"
source "$BR2_EXTERNAL_ECHOFORD_EXTERNAL_APP_PATH/src/driver/i2cappClient/Config.in"
```

## externalapp/package/hello_world/Config.in
```kconfig
config BR2_PACKAGE_HELLO_WORLD
    bool "Hello World Kernel Module"
    help
      A simple hello world kernel module.
```

## externalapp/src/driver/dht11/Config.in
```kconfig
config BR2_PACKAGE_DHT11
    bool "DHT11 Kernel Module"
    help
      A simple DHT11 kernel module.
```

## externalapp/src/driver/i2cappClient/Config.in
```kconfig
config BR2_PACKAGE_I2C_APP_CLIENT
    bool "I2C App Client Kernel Module"
    help
      A simple I2C App Client kernel module.
```
